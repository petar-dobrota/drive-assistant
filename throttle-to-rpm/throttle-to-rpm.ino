#include <U8glib.h>
#include "utility\u8g.h"

#include <Arduino.h>
#include <OBD.h>
#include <SD.h>
#include <DataLogger.h>


// obd adapter pinout:
// rx - white
// tx - green

////////////////////////////////////////////////////////////////////////////////////////////////////////////////////////////////////////////////////////////////////////////////////
// CONSTANTS
////////////////////////////////////////////////////////////////////////////////////////////////////////////////////////////////////////////////////////////////////////////////////

// PINS
const unsigned ALARM_PIN = 13;

const unsigned SD_CS_PIN = 10; // orange
// miso 12 yellow
// mosi 11 blue
// sck  13 white
const unsigned THROTTLE_POS_PIN = A0;

// TEST: DELETE
const unsigned TEST_0_PIN = 2;
const unsigned TEST_1_PIN = 3;
const unsigned TEST_2_PIN = 4;

const unsigned F_NAME_LEN = 13;

////////////////////////////////////////////////////////////////////////////////////////////////////////////////////////////////////////////////////////////////////////////////////
// GLOBALS
////////////////////////////////////////////////////////////////////////////////////////////////////////////////////////////////////////////////////////////////////////////////////

COBD obd;
DataLogger logger;

// obd data
float currRpm;
int currApp; // current value of Accelerator Pedal Position (APP) sensor

void signalError() {
  digitalWrite(TEST_0_PIN, LOW);
  while(true);
}

void setup()
{

  pinMode(ALARM_PIN, OUTPUT);

  pinMode(TEST_0_PIN, OUTPUT);
  pinMode(TEST_1_PIN, OUTPUT);
  pinMode(TEST_2_PIN, OUTPUT);
  
  digitalWrite(TEST_0_PIN, HIGH);
  digitalWrite(TEST_1_PIN, HIGH);
  digitalWrite(TEST_2_PIN, HIGH);

  if (!logger.begin(SD_CS_PIN)) {
    signalError();
  }

  obd.begin();
  while (!obd.init());

  digitalWrite(TEST_1_PIN, LOW);
}


////////////////////////////////////////////////////////////////////////////////////////////////////////////////////////////////////////////////////////////////////////////////////
// General functions
////////////////////////////////////////////////////////////////////////////////////////////////////////////////////////////////////////////////////////////////////////////////////

int obdRead(byte pid) {
  int value;
  if (obd.read(pid, value)) {
    return value;
  } else {
    // TODO: Stop exec
    return -1;
  }
}

// performs reads from all sensors(OBD, switches, APP)
void allReads() {
  currApp = analogRead(THROTTLE_POS_PIN);
  currRpm = (float) obdRead(PID_RPM);
}

////////////////////////////////////////////////////////////////////////////////////////////////////////////////////////////////////////////////////////////////////////////////////
// MAIN CORUTINES: 
// Will be called from main loop.
// Return true if no other co-routines should be called per a this loop
////////////////////////////////////////////////////////////////////////////////////////////////////////////////////////////////////////////////////////////////////////////////////


void functionMonitoring() {

  File f = logger.startLogging();

  f.print(millis());
  f.print(", ");
  
  f.print(currApp);
  f.print(", ");
  
  f.print(currRpm);
  f.print('\n');

  f.flush();
  f.close();
}

////////////////////////////////////////////////////////////////////////////////////////////////////////////////////////////////////////////////////////////////////////////////////
// LOOP
////////////////////////////////////////////////////////////////////////////////////////////////////////////////////////////////////////////////////////////////////////////////////
void loop()
{

  // read all sensor data
  allReads();

  functionMonitoring();
  
  delay(100);
}
